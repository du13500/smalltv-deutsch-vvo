// Generated by tools/generate_font.py. Original 5x7 Latin/Greek/Cyrillic pixel glyphs, MIT (Copyright 2026 du13500).
#pragma once
#include <stdint.h>
#include <stddef.h>
#ifdef ARDUINO
#include <pgmspace.h>
#else
#define PROGMEM
#define pgm_read_byte(p) (*(const uint8_t*)(p))
#define pgm_read_dword(p) (*(const uint32_t*)(p))
#endif
struct PixelGlyph { uint32_t cp; uint8_t rows[7]; };
static const uint8_t missingGlyph[7] PROGMEM={31,17,17,17,17,17,31};
static const PixelGlyph pixelGlyphs[] PROGMEM={
  {0x00A3,{6,9,8,28,8,8,31}}, // £
  {0x00AB,{0,0,10,20,10,0,0}}, // «
  {0x00B0,{6,9,9,6,0,0,0}}, // °
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  {0x2665,{0,10,31,31,14,4,0}}, // ♥
};
static inline uint8_t pixelRow(const uint8_t* p) { return pgm_read_byte(p); }
static inline const uint8_t* specialGlyph(uint32_t cp) {
  size_t lo=0,hi=sizeof(pixelGlyphs)/sizeof(pixelGlyphs[0]);
  while(lo<hi){size_t mid=lo+(hi-lo)/2;uint32_t key=pgm_read_dword(&pixelGlyphs[mid].cp);
    if(key==cp)return pixelGlyphs[mid].rows;
    if(key<cp)lo=mid+1;else hi=mid;
  }
  return nullptr;
}
struct PixelComposition { uint32_t base,mark,cp; };
static const PixelComposition pixelCompositions[] PROGMEM={
  {0x41,0x300,0xC0},
  {0x41,0x301,0xC1},
  {0x41,0x302,0xC2},
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  {0x456,0x308,0x457},
};
// Decode UTF-8 without consuming the ASCII byte following a broken sequence.
static inline bool decodeUtf8(const char* s,size_t n,size_t& i,uint32_t& cp) {
  if(i>=n)return false;
  uint8_t lead=(uint8_t)s[i++];
  if(lead<0x80){cp=lead;return true;}
  uint8_t count=0;uint32_t min=0;
  if(lead>=0xC2&&lead<=0xDF){count=1;cp=lead&31;min=0x80;}
  else if(lead>=0xE0&&lead<=0xEF){count=2;cp=lead&15;min=0x800;}
  else if(lead>=0xF0&&lead<=0xF4){count=3;cp=lead&7;min=0x10000;}
  else {cp=0xFFFD;return true;}
  for(uint8_t j=0;j<count;j++){
    if(i>=n||((uint8_t)s[i]&0xC0)!=0x80){cp=0xFFFD;return true;}
    cp=(cp<<6)|((uint8_t)s[i++]&63);
  }
  if(cp<min||cp>0x10FFFF||(cp>=0xD800&&cp<=0xDFFF))cp=0xFFFD;
  return true;
}
static inline bool heartCodepoint(uint32_t cp) {
  return cp==0x2661||cp==0x2665||cp==0x2764||cp==0x2765||cp==0x2763||
    cp==0x1F49F||(cp>=0x1F493&&cp<=0x1F49E)||cp==0x1F5A4||
    cp==0x1F90D||cp==0x1F90E||(cp>=0x1FA75&&cp<=0x1FA77);
}
static inline bool nextDisplayCodepoint(const char* s,size_t n,size_t& i,uint32_t& cp) {
  // Selectors choose emoji/text presentation; they do not occupy a display cell.
  do {if(!decodeUtf8(s,n,i,cp))return false;} while(cp==0xFE0E||cp==0xFE0F);
  bool heart=heartCodepoint(cp);
  if(heart)cp=0x2665;
  while(i<n){
    size_t next=i;uint32_t mark=0;decodeUtf8(s,n,next,mark);
    if(mark==0xFE0E||mark==0xFE0F){i=next;continue;}
    // Heart on fire / mending heart are rendered as one ordinary pixel heart.
    if(heart&&mark==0x200D){
      size_t end=next;uint32_t joined=0;
      if(decodeUtf8(s,n,end,joined)&&(joined==0x1F525||joined==0x1FA79)){i=end;continue;}
    }
    if(mark<0x300||mark>0x36F)break;
    bool composed=false;
    for(size_t k=0;k<sizeof(pixelCompositions)/sizeof(pixelCompositions[0]);k++){
      const auto& c=pixelCompositions[k];
      if(pgm_read_dword(&c.base)==cp&&pgm_read_dword(&c.mark)==mark){cp=pgm_read_dword(&c.cp);i=next;composed=true;break;}
    }
    if(!composed)break;
  }
  return true;
}
